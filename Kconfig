## Kconfig
```kconfig
# Copyright (c) 2025 Kiran
# SPDX-License-Identifier: MIT

rsource "boards/shields/*/Kconfig.shield"
rsource "boards/shields/*/Kconfig.defconfig"
```

## boards/shields/kiran_flake/Kconfig.defconfig
```kconfig
if SHIELD_KIRAN_FLAKE

config ZMK_KEYBOARD_NAME
    default "Kiran Flake"

# Enable ZMK Studio if desired
# config ZMK_STUDIO
#     default y

endif
```

## config/boards/shields/kiran_flake/Kconfig.defconfig
```kconfig
if SHIELD_KIRAN_FLAKE
            
config ZMK_KEYBOARD_NAME
    default "kiran_flake"

endif
```

## config/boards/shields/seed_xiao_6x5/Kconfig.defconfig
```kconfig
if SHIELD_SEED_XIAO_6X5

config ZMK_KEYBOARD_NAME
    default "seed_xiao_6x5"

endif
```

## config/west.yml
```yaml
manifest:
  remotes:
    - name: zmkfirmware
      url-base: https://github.com
  projects:
    - name: zmk
      remote: zmkfirmware
      revision: main
      path: zmk
  self:
    path: config
```
